ENTRY(kernel_main)

SECTIONS {
    /* Set the load address for the kernel (2MB mark is common) */
    . = 0x200000; 

    .text : ALIGN(0x1000) {
        *(.text*)
    }

    .rodata : ALIGN(0x1000) {
        *(.rodata*)
    }

    .data : ALIGN(0x1000) {
        *(.data*)
    }

    .bss : ALIGN(0x1000) {
        *(COMMON)
        *(.bss*)
    }
}
